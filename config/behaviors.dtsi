#define KEYS_L LT0 LT1 LT2 LT3 LT4 LM0 LM1 LM2 LM3 LM4 LB0 LB1 LB2 LB3 LB4
#define KEYS_R RT0 RT1 RT2 RT3 RT4 RM0 RM1 RM2 RM3 RM4 RB0 RB1 RB2 RB3 RB4
#define THUMBS LH1 LH0 RH0 RH1

&lt {
    tapping-term-ms = <120>;
    flavor = "balanced";
    require-prior-idle-ms = <150>;
};

&mt {
    tapping-term-ms = <120>;
    flavor = "balanced";
    require-prior-idle-ms = <90>;
};

ZMK_BEHAVIOR(mod_kr, hold_tap,
    tapping-term-ms = <120>;
    flavor = "balanced";
    require-prior-idle-ms = <150>;
    bindings = <&kp>, <&key_repeat>;
)

/* Left-hand HRMs. */
ZMK_HOLD_TAP(hml,
    flavor = "balanced";
    tapping-term-ms = <280>;
    quick-tap-ms = <175>;
    require-prior-idle-ms = <150>;
    bindings = <&kp>, <&kp>;
    hold-trigger-key-positions = <KEYS_R THUMBS>;
    hold-trigger-on-release;
)

/* Right-hand HRMs. */
ZMK_HOLD_TAP(hmr,
    flavor = "balanced";
    tapping-term-ms = <280>;
    quick-tap-ms = <175>;
    require-prior-idle-ms = <150>;
    bindings = <&kp>, <&kp>;
    hold-trigger-key-positions = <KEYS_L THUMBS>;
    hold-trigger-on-release;
)
/*sticky mod tap*/
ZMK_HOLD_TAP(mod_sk,
    flavor = "balanced";
    tapping-term-ms = <280>;
    require-prior-idle-ms = <150>;
    bindings = <&kp>, <&sk>;
)
ZMK_HOLD_TAP(ltd,
    flavor = "hold-preferred";
    tapping-term-ms = <400>;
    require-prior-idle-ms = <250>;
    bindings = <&mo>, <&kp>;
)
